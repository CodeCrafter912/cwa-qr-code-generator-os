## configs/raspberrypi0w_defconfig
```kconfig
BR2_arm=y
BR2_arm1176jzf_s=y
BR2_PACKAGE_HOST_LINUX_HEADERS_CUSTOM_5_10=y
BR2_TOOLCHAIN_BUILDROOT_WCHAR=y
BR2_TOOLCHAIN_BUILDROOT_CXX=y
BR2_ROOTFS_OVERLAY="$(BR2_EXTERNAL)/board/raspberrypi/rootfs_overlay"
BR2_ROOTFS_POST_BUILD_SCRIPT="$(BR2_EXTERNAL)/board/raspberrypi/post-build.sh"
BR2_ROOTFS_POST_IMAGE_SCRIPT="$(BR2_EXTERNAL)/board/raspberrypi/post-image.sh"
BR2_ROOTFS_POST_SCRIPT_ARGS="-b raspberrypi0w"
BR2_LINUX_KERNEL=y
BR2_LINUX_KERNEL_CUSTOM_TARBALL=y
BR2_LINUX_KERNEL_CUSTOM_TARBALL_LOCATION="$(call github,raspberrypi,linux,967d45b29ca2902f031b867809d72e3b3d623e7a)/linux-967d45b29ca2902f031b867809d72e3b3d623e7a.tar.gz"
BR2_LINUX_KERNEL_DEFCONFIG="bcmrpi"
BR2_LINUX_KERNEL_DTS_SUPPORT=y
BR2_LINUX_KERNEL_INTREE_DTS_NAME="bcm2708-rpi-zero-w"
BR2_LINUX_KERNEL_NEEDS_HOST_OPENSSL=y
BR2_PACKAGE_QT5=y
BR2_PACKAGE_QT5BASE_DEFAULT_QPA="linuxfb"
BR2_PACKAGE_RPI_FIRMWARE=y
# BR2_PACKAGE_RPI_FIRMWARE_INSTALL_DTB_OVERLAYS is not set
BR2_TARGET_ROOTFS_EXT2=y
BR2_TARGET_ROOTFS_EXT2_4=y
BR2_TARGET_ROOTFS_EXT2_SIZE="120M"
# BR2_TARGET_ROOTFS_TAR is not set
BR2_PACKAGE_HOST_DOSFSTOOLS=y
BR2_PACKAGE_HOST_GENIMAGE=y
BR2_PACKAGE_HOST_MTOOLS=y
BR2_PACKAGE_CWAQRCODEGENERATOR=y
```

## package/cwa-qr-code-generator/Config.in
```kconfig
config BR2_PACKAGE_CWA_QR_CODE_GENERATOR
    bool "cwa-qr-code-generator"
    depends on BR2_PACKAGE_QT5
    select BR2_PACKAGE_QT5BASE
    select BR2_PACKAGE_QT5MULTIMEDIA
    select BR2_PACKAGE_QT5QUICKCONTROLS2
    select BR2_PACKAGE_QT5BASE_PNG
    select BR2_PACKAGE_QT5BASE_WIDGETS
    select BR2_PACKAGE_PROTOBUF
    select BR2_PACKAGE_RNG_TOOLS
    select BR2_PACKAGE_RNG_TOOLS_JITTERENTROPY_LIBRARY
    help
      This package contains the cwa-qr-code-generator.

      https://github.com/CodeCrafter912/cwa-qr-code-generator

comment "cwa-qr-code-generator needs Qt5"
    depends on !BR2_PACKAGE_QT5
```
